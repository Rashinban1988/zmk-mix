## config/west.yml
```yaml
manifest:
  remotes:
  - name: zmkfirmware
    url-base: https://github.com/zmkfirmware
  - name: mctechnology17
    url-base: https://github.com/mctechnology17

    
  projects:
  - name: zmk
    remote: zmkfirmware
    revision: v0.3
    import: app/west.yml
  - name: cirque-input-module
    url: https://github.com/petejohanson/cirque-input-module
    revision: 0de55f36bc720b5be3d8880dc856d4d78baf5214
    path: modules/cirque-input-module
  - name: zmk-nice-oled
    remote: mctechnology17
    revision: 46f824abb2bd41f1287c5c68abd14122af6042a3
  self:
    path: config
```
